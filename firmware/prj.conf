## CMakeLists.txt
```
# ══════════════════════════════════════
# PART:   Pod Firmware — Build Configuration
# ACTOR:  Claude Opus 4.6
# PHASE:  18 — Zephyr RTOS + BLE GATT
# ══════════════════════════════════════

cmake_minimum_required(VERSION 3.20.0)
find_package(Zephyr REQUIRED HINTS $ENV{ZEPHYR_BASE})

project(ara_patch VERSION 1.0.0 LANGUAGES C)

target_sources(app PRIVATE
    src/main.c
    src/ble_service.c
    src/drivers/max86176.c
    src/drivers/lsm6dso.c
    src/drivers/ntc_adc.c
    src/drivers/mems_mic.c
)

target_include_directories(app PRIVATE
    src/
    src/drivers/
)
```

## prj.conf
```kconfig
# ══════════════════════════════════════
# PART:   Pod Firmware — Zephyr Kconfig
# ACTOR:  Claude Opus 4.6
# PHASE:  18 — nRF52840 Configuration
# ══════════════════════════════════════

# ── BLE Stack ──
CONFIG_BT=y
CONFIG_BT_PERIPHERAL=y
CONFIG_BT_DEVICE_NAME="ARA-PATCH"
CONFIG_BT_DEVICE_NAME_DYNAMIC=y
CONFIG_BT_MAX_CONN=1
CONFIG_BT_GAP_AUTO_UPDATE_CONN_PARAMS=y
CONFIG_BT_GATT_DYNAMIC_DB=y
CONFIG_BT_L2CAP_TX_MTU=247
CONFIG_BT_BUF_ACL_TX_SIZE=251

# ── Peripherals ──
CONFIG_I2C=y
CONFIG_SPI=y
CONFIG_ADC=y
CONFIG_NRFX_PDM=y

# ── Logging ──
CONFIG_LOG=y
CONFIG_LOG_DEFAULT_LEVEL=3

# ── System ──
CONFIG_SYSTEM_WORKQUEUE_STACK_SIZE=2048
CONFIG_HEAP_MEM_POOL_SIZE=4096
CONFIG_MAIN_STACK_SIZE=2048

# ── Power ──
CONFIG_PM=y
CONFIG_PM_DEVICE=y
```

## boards/nrf52840dk_nrf52840.overlay
```dts
/*
 * ══════════════════════════════════════
 * PART:   Pod Firmware — Device Tree Overlay
 * ACTOR:  Claude Opus 4.6
 * PHASE:  18 — nRF52840-DK Pin Mapping
 * ══════════════════════════════════════
 *
 * Pin assignments for ARA Patch sensors:
 *   I2C0: SDA=P0.26, SCL=P0.27 → MAX86176 PPG
 *   SPI1: MOSI=P0.13, MISO=P0.14, SCK=P0.15, CS=P0.11 → LSM6DSO IMU
 *   ADC:  AIN0=P0.02 → NTC Thermistor
 *   PDM:  CLK=P0.25, DATA=P0.24 → MEMS Microphone
 */

&i2c0 {
    status = "okay";
    compatible = "nordic,nrf-twim";
    sda-pin = <26>;
    scl-pin = <27>;
    clock-frequency = <I2C_BITRATE_FAST>;  /* 400kHz */
};

&spi1 {
    status = "okay";
    compatible = "nordic,nrf-spim";
    sck-pin = <15>;
    mosi-pin = <13>;
    miso-pin = <14>;
    cs-gpios = <&gpio0 11 GPIO_ACTIVE_LOW>;
};

&adc {
    status = "okay";
    #address-cells = <1>;
    #size-cells = <0>;

    channel@0 {
        reg = <0>;
        zephyr,gain = "ADC_GAIN_1_6";
        zephyr,reference = "ADC_REF_INTERNAL";
        zephyr,acquisition-time = <ADC_ACQ_TIME_DEFAULT>;
        zephyr,input-positive = <NRF_SAADC_AIN0>;  /* P0.02 */
        zephyr,resolution = <12>;
    };
};
```

## src/main.c
```c
/**
 * ══════════════════════════════════════
 * PART:   ARA Patch Firmware — Entry Point
 * ACTOR:  Claude Opus 4.6
 * PHASE:  18 — Zephyr RTOS Main
 * ══════════════════════════════════════
 *
 * nRF52840-DK entry point for ARA Health Patch
 *
 * Threads:
 *   ppg_thread   — MAX86176 PPG read @ 25Hz (K_PRIO_COOP 5)
 *   imu_thread   — LSM6DSO IMU read @ 25Hz  (K_PRIO_COOP 6)
 *   temp_thread  — NTC thermistor @ 1Hz      (K_PRIO_COOP 7)
 *   mic_thread   — MEMS mic on-demand         (K_PRIO_COOP 8)
 *
 * Main loop: pack sensor data → BLE notify @ 25Hz (40ms)
 */

#include <zephyr/kernel.h>
#include <zephyr/bluetooth/bluetooth.h>
#include <zephyr/logging/log.h>
#include <string.h>

#include "ble_service.h"
#include "drivers/max86176.h"
#include "drivers/lsm6dso.h"
#include "drivers/ntc_adc.h"
#include "drivers/mems_mic.h"

LOG_MODULE_REGISTER(ara_main, LOG_LEVEL_INF);

/* ── Thread Stacks ── */
#define STACK_SIZE 1024
K_THREAD_STACK_DEFINE(ppg_stack,  STACK_SIZE);
K_THREAD_STACK_DEFINE(imu_stack,  STACK_SIZE);
K_THREAD_STACK_DEFINE(temp_stack, STACK_SIZE);
K_THREAD_STACK_DEFINE(mic_stack,  STACK_SIZE);

static struct k_thread ppg_thread;
static struct k_thread imu_thread;
static struct k_thread temp_thread;
static struct k_thread mic_thread;

/* ── Shared Sensor State (updated by driver threads) ── */
static struct {
    /* PPG */
    int16_t ppg_samples[6];
    int16_t ppg_red_ac[2], ppg_red_dc[2];
    int16_t ppg_ir_ac[2], ppg_ir_dc[2];
    uint16_t ppg_seq;
    uint16_t hr_x10;       /* HR × 10 */
    uint8_t  spo2;

    /* IMU */
    float accel_g[3];
    float gyro_dps[3];
    bool  motion_flag;

    /* Temperature */
    float temperature;

    /* Contact detect (from PPG IR DC level) */
    bool contact_flag;
} sensor_state;

static K_MUTEX_DEFINE(sensor_mutex);

/* ── Disconnect idle timer ── */
static int64_t last_connected_time;

/* ── PPG Read Thread ── */
static void ppg_read_loop(void *p1, void *p2, void *p3)
{
    ARG_UNUSED(p1); ARG_UNUSED(p2); ARG_UNUSED(p3);

    while (1) {
        struct max86176_sample samples[4];
        int count = max86176_read_fifo(samples, 4);

        if (count > 0) {
            k_mutex_lock(&sensor_mutex, K_FOREVER);

            /* Store last 6 PPG samples (IR channel) for sensor packet */
            for (int i = 0; i < count && i < 6; i++) {
                sensor_state.ppg_samples[i] = samples[i].ir_raw >> 4;
            }

            /* Store AC/DC for SpO₂ (last 2 samples) */
            int last = (count > 2) ? count - 2 : 0;
            for (int i = 0; i < 2 && (last + i) < count; i++) {
                sensor_state.ppg_red_ac[i] = samples[last + i].red_ac;
                sensor_state.ppg_red_dc[i] = samples[last + i].red_dc;
                sensor_state.ppg_ir_ac[i]  = samples[last + i].ir_ac;
                sensor_state.ppg_ir_dc[i]  = samples[last + i].ir_dc;
            }

            sensor_state.ppg_seq++;

            /* Contact detection: IR DC > threshold = skin contact */
            sensor_state.contact_flag =
                (samples[count - 1].ir_dc > MAX86176_CONTACT_THRESHOLD);

            k_mutex_unlock(&sensor_mutex);
        }

        k_sleep(K_MSEC(40));  /* 25Hz */
    }
}

/* ── IMU Read Thread ── */
static void imu_read_loop(void *p1, void *p2, void *p3)
{
    ARG_UNUSED(p1); ARG_UNUSED(p2); ARG_UNUSED(p3);

    struct lsm6dso_data imu_data;

    while (1) {
        if (lsm6dso_read(&imu_data) == 0) {
            k_mutex_lock(&sensor_mutex, K_FOREVER);

            memcpy(sensor_state.accel_g, imu_data.accel_g, sizeof(float) * 3);
            memcpy(sensor_state.gyro_dps, imu_data.gyro_dps, sizeof(float) * 3);

            /* Motion detection: |accel| > 2.0g */
            float mag = imu_data.accel_g[0] * imu_data.accel_g[0] +
                        imu_data.accel_g[1] * imu_data.accel_g[1] +
                        imu_data.accel_g[2] * imu_data.accel_g[2];
            sensor_state.motion_flag = (mag > 4.0f);  /* 2.0² = 4.0 */

            k_mutex_unlock(&sensor_mutex);
        }

        k_sleep(K_MSEC(40));  /* 25Hz (decimated from 104Hz ODR) */
    }
}

/* ── Temperature Read Thread ── */
static void temp_read_loop(void *p1, void *p2, void *p3)
{
    ARG_UNUSED(p1); ARG_UNUSED(p2); ARG_UNUSED(p3);

    while (1) {
        float temp = ntc_adc_read_celsius();
        if (temp > 0.0f) {
            k_mutex_lock(&sensor_mutex, K_FOREVER);
            sensor_state.temperature = temp;
            k_mutex_unlock(&sensor_mutex);
        }

        k_sleep(K_MSEC(1000));  /* 1Hz — temperature changes slowly */
    }
}

/* ── Microphone Thread (on-demand) ── */
static void mic_read_loop(void *p1, void *p2, void *p3)
{
    ARG_UNUSED(p1); ARG_UNUSED(p2); ARG_UNUSED(p3);

    uint8_t audio_buf[20];  /* 8 int16 samples + 2B seq + 2B flags */
    uint16_t audio_seq = 0;

    while (1) {
        uint8_t cmd = ara_ble_get_audio_cmd();

        if (cmd == ARA_AUDIO_CMD_VOICE || cmd == ARA_AUDIO_CMD_GUT) {
            int duration_ms = (cmd == ARA_AUDIO_CMD_VOICE) ? 5000 : 30000;
            int total_samples = (duration_ms / 1000) * 16000;  /* 16kHz */
            int packets = total_samples / 16;  /* 8 samples at 8kHz after downsample */

            LOG_INF("Mic recording started: %dms (%d packets)", duration_ms, packets);
            mems_mic_start();

            for (int p = 0; p < packets; p++) {
                if (ara_ble_get_audio_cmd() == ARA_AUDIO_CMD_STOP) {
                    break;
                }

                int16_t pcm[8];
                mems_mic_read_downsampled(pcm, 8);

                memcpy(audio_buf, pcm, 16);
                audio_buf[16] = (uint8_t)(audio_seq & 0xFF);
                audio_buf[17] = (uint8_t)(audio_seq >> 8);
                audio_buf[18] = cmd;
                audio_buf[19] = 0;
                audio_seq++;

                ara_ble_notify_audio(audio_buf, 20);
                k_sleep(K_MSEC(1));  /* pace BLE notifications */
            }

            mems_mic_stop();
            LOG_INF("Mic recording complete");
        }

        k_sleep(K_MSEC(100));  /* poll for commands */
    }
}

/* ── Main Entry ── */
void main(void)
{
    LOG_INF("ARA Patch Firmware v1.0.0 starting...");

    /* 1. Init BLE stack */
    int err = bt_enable(NULL);
    if (err) {
        LOG_ERR("Bluetooth init failed (err %d)", err);
        return;
    }
    LOG_INF("Bluetooth initialized");

    err = ara_ble_service_init();
    if (err) {
        LOG_ERR("BLE service init failed (err %d)", err);
        return;
    }

    /* 2. Init sensor drivers */
    err = max86176_init();
    if (err) { LOG_ERR("MAX86176 init failed (err %d)", err); }

    err = lsm6dso_init();
    if (err) { LOG_ERR("LSM6DSO init failed (err %d)", err); }

    err = ntc_adc_init();
    if (err) { LOG_ERR("NTC ADC init failed (err %d)", err); }

    err = mems_mic_init();
    if (err) { LOG_ERR("MEMS mic init failed (err %d)", err); }

    /* 3. Start sensor threads */
    k_thread_create(&ppg_thread, ppg_stack, STACK_SIZE,
                    ppg_read_loop, NULL, NULL, NULL,
                    K_PRIO_COOP(5), 0, K_NO_WAIT);
    k_thread_name_set(&ppg_thread, "ppg");

    k_thread_create(&imu_thread, imu_stack, STACK_SIZE,
                    imu_read_loop, NULL, NULL, NULL,
                    K_PRIO_COOP(6), 0, K_NO_WAIT);
    k_thread_name_set(&imu_thread, "imu");

    k_thread_create(&temp_thread, temp_stack, STACK_SIZE,
                    temp_read_loop, NULL, NULL, NULL,
                    K_PRIO_COOP(7), 0, K_NO_WAIT);
    k_thread_name_set(&temp_thread, "temp");

    k_thread_create(&mic_thread, mic_stack, STACK_SIZE,
                    mic_read_loop, NULL, NULL, NULL,
                    K_PRIO_COOP(8), 0, K_NO_WAIT);
    k_thread_name_set(&mic_thread, "mic");

    LOG_INF("All sensor threads started");

    /* 4. Main loop: pack sensor data → BLE notify @ 25Hz */
    last_connected_time = k_uptime_get();

    while (1) {
        if (ara_ble_is_connected()) {
            last_connected_time = k_uptime_get();

            /* Pack sensor data packet */
            struct ara_sensor_packet sensor_pkt;
            struct ara_ppg_raw_packet ppg_pkt;

            k_mutex_lock(&sensor_mutex, K_FOREVER);

            sensor_pkt.hr_x10 = sensor_state.hr_x10;
            sensor_pkt.spo2 = sensor_state.spo2;
            sensor_pkt.temperature = sensor_state.temperature;
            memcpy(sensor_pkt.ppg_samples, sensor_state.ppg_samples,
                   sizeof(int16_t) * 6);
            sensor_pkt.flags = 0;
            if (sensor_state.motion_flag)  sensor_pkt.flags |= 0x01;
            if (sensor_state.contact_flag) sensor_pkt.flags |= 0x02;

            /* Pack PPG raw packet for SpO₂ */
            memcpy(ppg_pkt.red_ac, sensor_state.ppg_red_ac, sizeof(int16_t) * 2);
            memcpy(ppg_pkt.red_dc, sensor_state.ppg_red_dc, sizeof(int16_t) * 2);
            memcpy(ppg_pkt.ir_ac, sensor_state.ppg_ir_ac, sizeof(int16_t) * 2);
            memcpy(ppg_pkt.ir_dc, sensor_state.ppg_ir_dc, sizeof(int16_t) * 2);
            ppg_pkt.seq = sensor_state.ppg_seq;
            ppg_pkt.flags = sensor_pkt.flags;

            k_mutex_unlock(&sensor_mutex);

            /* Send BLE notifications */
            ara_ble_notify_sensor_data(&sensor_pkt);
            ara_ble_notify_ppg_raw(&ppg_pkt);

        } else {
            /* Power management: idle if disconnected > 60s */
            int64_t now = k_uptime_get();
            if ((now - last_connected_time) > 60000) {
                k_cpu_idle();
            }
        }

        k_sleep(K_MSEC(40));  /* 25Hz main loop */
    }
}
```

## src/ble_service.c
```c
/**
 * ══════════════════════════════════════
 * PART:   ARA Health BLE GATT Service
 * ACTOR:  Claude Opus 4.6
 * PHASE:  18 — BLE Service Implementation
 * ══════════════════════════════════════
 *
 * Custom GATT service for ARA Patch with 4 characteristics:
 *   ARA1: Sensor Data (notify, 20B @ 25Hz)
 *   ARA2: PPG Raw     (notify, 20B for SpO₂)
 *   ARA3: Patch ID    (read-only)
 *   ARA4: Audio       (notify + write for mic control)
 */

#include <zephyr/kernel.h>
#include <zephyr/bluetooth/bluetooth.h>
#include <zephyr/bluetooth/gatt.h>
#include <zephyr/bluetooth/uuid.h>
#include <zephyr/logging/log.h>
#include <string.h>

#include "ble_service.h"

LOG_MODULE_REGISTER(ara_ble, LOG_LEVEL_INF);

/* ── State ── */
static bool ble_connected;
static uint8_t audio_cmd;  /* current mic command */
static char patch_id[32];

/* ── UUID Declarations ── */
static struct bt_uuid_128 ara_svc_uuid = BT_UUID_INIT_128(ARA_SERVICE_UUID);
static struct bt_uuid_128 sensor_data_uuid = BT_UUID_INIT_128(ARA_CHAR_SENSOR_DATA_UUID);
static struct bt_uuid_128 ppg_raw_uuid = BT_UUID_INIT_128(ARA_CHAR_PPG_RAW_UUID);
static struct bt_uuid_128 patch_id_uuid = BT_UUID_INIT_128(ARA_CHAR_PATCH_ID_UUID);
static struct bt_uuid_128 audio_uuid = BT_UUID_INIT_128(ARA_CHAR_AUDIO_UUID);

/* ── Patch ID Read Callback ── */
static ssize_t read_patch_id(struct bt_conn *conn,
                             const struct bt_gatt_attr *attr,
                             void *buf, uint16_t len, uint16_t offset)
{
    return bt_gatt_attr_read(conn, attr, buf, len, offset,
                             patch_id, strlen(patch_id));
}

/* ── Audio Command Write Callback ── */
static ssize_t write_audio_cmd(struct bt_conn *conn,
                               const struct bt_gatt_attr *attr,
                               const void *buf, uint16_t len,
                               uint16_t offset, uint8_t flags)
{
    if (len != 1) {
        return BT_GATT_ERR(BT_ATT_ERR_INVALID_ATTRIBUTE_LEN);
    }

    uint8_t cmd = ((const uint8_t *)buf)[0];
    if (cmd != ARA_AUDIO_CMD_VOICE &&
        cmd != ARA_AUDIO_CMD_GUT &&
        cmd != ARA_AUDIO_CMD_STOP) {
        return BT_GATT_ERR(BT_ATT_ERR_VALUE_NOT_ALLOWED);
    }

    audio_cmd = cmd;
    LOG_INF("Audio command received: 0x%02X", cmd);
    return len;
}

/* ── CCC Changed Callbacks ── */
static void sensor_data_ccc_changed(const struct bt_gatt_attr *attr, uint16_t value)
{
    LOG_INF("Sensor data notifications %s",
            (value == BT_GATT_CCC_NOTIFY) ? "enabled" : "disabled");
}

static void ppg_raw_ccc_changed(const struct bt_gatt_attr *attr, uint16_t value)
{
    LOG_INF("PPG raw notifications %s",
            (value == BT_GATT_CCC_NOTIFY) ? "enabled" : "disabled");
}

static void audio_ccc_changed(const struct bt_gatt_attr *attr, uint16_t value)
{
    LOG_INF("Audio notifications %s",
            (value == BT_GATT_CCC_NOTIFY) ? "enabled" : "disabled");
}

/* ── GATT Service Definition ── */
BT_GATT_SERVICE_DEFINE(ara_svc,
    /* Primary Service */
    BT_GATT_PRIMARY_SERVICE(&ara_svc_uuid),

    /* Characteristic 1: Sensor Data (notify) */
    BT_GATT_CHARACTERISTIC(&sensor_data_uuid.uuid,
                           BT_GATT_CHRC_NOTIFY,
                           BT_GATT_PERM_NONE,
                           NULL, NULL, NULL),
    BT_GATT_CCC(sensor_data_ccc_changed,
                 BT_GATT_PERM_READ | BT_GATT_PERM_WRITE),

    /* Characteristic 2: PPG Raw (notify) */
    BT_GATT_CHARACTERISTIC(&ppg_raw_uuid.uuid,
                           BT_GATT_CHRC_NOTIFY,
                           BT_GATT_PERM_NONE,
                           NULL, NULL, NULL),
    BT_GATT_CCC(ppg_raw_ccc_changed,
                 BT_GATT_PERM_READ | BT_GATT_PERM_WRITE),

    /* Characteristic 3: Patch ID (read) */
    BT_GATT_CHARACTERISTIC(&patch_id_uuid.uuid,
                           BT_GATT_CHRC_READ,
                           BT_GATT_PERM_READ,
                           read_patch_id, NULL, NULL),

    /* Characteristic 4: Audio (notify + write) */
    BT_GATT_CHARACTERISTIC(&audio_uuid.uuid,
                           BT_GATT_CHRC_NOTIFY | BT_GATT_CHRC_WRITE,
                           BT_GATT_PERM_WRITE,
                           NULL, write_audio_cmd, NULL),
    BT_GATT_CCC(audio_ccc_changed,
                 BT_GATT_PERM_READ | BT_GATT_PERM_WRITE),
);

/* ── Connection Callbacks ── */
static void connected(struct bt_conn *conn, uint8_t err)
{
    if (err) {
        LOG_ERR("Connection failed (err 0x%02x)", err);
        return;
    }
    ble_connected = true;
    audio_cmd = ARA_AUDIO_CMD_STOP;
    LOG_INF("BLE connected");
}

static void disconnected(struct bt_conn *conn, uint8_t reason)
{
    ble_connected = false;
    audio_cmd = ARA_AUDIO_CMD_STOP;
    LOG_INF("BLE disconnected (reason 0x%02x)", reason);
}

BT_CONN_CB_DEFINE(conn_callbacks) = {
    .connected = connected,
    .disconnected = disconnected,
};

/* ── Advertising Data ── */
static const struct bt_data ad[] = {
    BT_DATA_BYTES(BT_DATA_FLAGS,
                  (BT_LE_AD_GENERAL | BT_LE_AD_NO_BREDR)),
    BT_DATA(BT_DATA_NAME_COMPLETE, "ARA-PATCH", 9),
};

/* ── Public API ── */

int ara_ble_service_init(void)
{
    /* Build Patch ID string */
    bt_addr_le_t addr;
    size_t count = 1;
    bt_id_get(&addr, &count);
    snprintf(patch_id, sizeof(patch_id), "ARA-PATCH-%02X%02X-P1-1.0.0",
             addr.a.val[1], addr.a.val[0]);
    LOG_INF("Patch ID: %s", patch_id);

    /* Start advertising */
    int err = bt_le_adv_start(BT_LE_ADV_CONN, ad, ARRAY_SIZE(ad), NULL, 0);
    if (err) {
        LOG_ERR("Advertising failed to start (err %d)", err);
        return err;
    }
    LOG_INF("BLE advertising started");
    return 0;
}

int ara_ble_notify_sensor_data(const struct ara_sensor_packet *pkt)
{
    if (!ble_connected) {
        return -ENOTCONN;
    }
    return bt_gatt_notify(NULL, &ara_svc.attrs[2], pkt,
                          sizeof(struct ara_sensor_packet));
}

int ara_ble_notify_ppg_raw(const struct ara_ppg_raw_packet *pkt)
{
    if (!ble_connected) {
        return -ENOTCONN;
    }
    return bt_gatt_notify(NULL, &ara_svc.attrs[5], pkt,
                          sizeof(struct ara_ppg_raw_packet));
}

int ara_ble_notify_audio(const uint8_t *data, uint16_t len)
{
    if (!ble_connected || len > 20) {
        return -EINVAL;
    }
    return bt_gatt_notify(NULL, &ara_svc.attrs[11], data, len);
}

bool ara_ble_is_connected(void)
{
    return ble_connected;
}

uint8_t ara_ble_get_audio_cmd(void)
{
    return audio_cmd;
}
```

## src/ble_service.h
```c
/**
 * ══════════════════════════════════════
 * PART:   ARA Health BLE GATT Service
 * ACTOR:  Claude Opus 4.6
 * PHASE:  18 — BLE Service Interface
 * ══════════════════════════════════════
 */

#ifndef ARA_BLE_SERVICE_H
#define ARA_BLE_SERVICE_H

#include <zephyr/types.h>
#include <zephyr/bluetooth/bluetooth.h>
#include <zephyr/bluetooth/gatt.h>

/* ── Service UUID: 0000ARA0-0000-1000-8000-00805F9B34FB ── */
#define ARA_SERVICE_UUID \
    BT_UUID_128_ENCODE(0x0000ARA0, 0x0000, 0x1000, 0x8000, 0x00805F9B34FB)

/* ── Characteristic UUIDs ── */
#define ARA_CHAR_SENSOR_DATA_UUID \
    BT_UUID_128_ENCODE(0x0000ARA1, 0x0000, 0x1000, 0x8000, 0x00805F9B34FB)

#define ARA_CHAR_PPG_RAW_UUID \
    BT_UUID_128_ENCODE(0x0000ARA2, 0x0000, 0x1000, 0x8000, 0x00805F9B34FB)

#define ARA_CHAR_PATCH_ID_UUID \
    BT_UUID_128_ENCODE(0x0000ARA3, 0x0000, 0x1000, 0x8000, 0x00805F9B34FB)

#define ARA_CHAR_AUDIO_UUID \
    BT_UUID_128_ENCODE(0x0000ARA4, 0x0000, 0x1000, 0x8000, 0x00805F9B34FB)

/* ── Sensor Data Packet (20 bytes) ── */
struct ara_sensor_packet {
    uint16_t hr_x10;        /* HR × 10, e.g. 725 = 72.5 BPM */
    uint8_t  spo2;          /* SpO₂ percentage */
    float    temperature;   /* Celsius, float32 */
    int16_t  ppg_samples[6];/* Last 6 PPG samples (25Hz) */
    uint8_t  flags;         /* bit0=motion, bit1=contact */
} __packed;

/* ── PPG Raw Packet (20 bytes) ── */
struct ara_ppg_raw_packet {
    int16_t red_ac[2];
    int16_t red_dc[2];
    int16_t ir_ac[2];
    int16_t ir_dc[2];
    uint16_t seq;
    uint16_t flags;
} __packed;

/* ── Audio Command Bytes ── */
#define ARA_AUDIO_CMD_VOICE  0x01   /* 5s voice check */
#define ARA_AUDIO_CMD_GUT    0x02   /* 30s gut sound */
#define ARA_AUDIO_CMD_STOP   0x00

/* ── API ── */
int ara_ble_service_init(void);
int ara_ble_notify_sensor_data(const struct ara_sensor_packet *pkt);
int ara_ble_notify_ppg_raw(const struct ara_ppg_raw_packet *pkt);
int ara_ble_notify_audio(const uint8_t *data, uint16_t len);
bool ara_ble_is_connected(void);
uint8_t ara_ble_get_audio_cmd(void);

#endif /* ARA_BLE_SERVICE_H */
```
